
void testlines(uint16_t color) {
  tft.fillScreen(ST77XX_BLACK);
  for (int16_t x = 0; x < tft.width(); x += 6) {
    tft.drawLine(0, 0, x, tft.height() - 1, color);
    delay(0);
  }
  for (int16_t y = 0; y < tft.height(); y += 6) {
    tft.drawLine(0, 0, tft.width() - 1, y, color);
    delay(0);
  }

  tft.fillScreen(ST77XX_BLACK);
  for (int16_t x = 0; x < tft.width(); x += 6) {
    tft.drawLine(tft.width() - 1, 0, x, tft.height() - 1, color);
    delay(0);
  }
  for (int16_t y = 0; y < tft.height(); y += 6) {
    tft.drawLine(tft.width() - 1, 0, 0, y, color);
    delay(0);
  }

  tft.fillScreen(ST77XX_BLACK);
  for (int16_t x = 0; x < tft.width(); x += 6) {
    tft.drawLine(0, tft.height() - 1, x, 0, color);
    delay(0);
  }
  for (int16_t y = 0; y < tft.height(); y += 6) {
    tft.drawLine(0, tft.height() - 1, tft.width() - 1, y, color);
    delay(0);
  }

  tft.fillScreen(ST77XX_BLACK);
  for (int16_t x = 0; x < tft.width(); x += 6) {
    tft.drawLine(tft.width() - 1, tft.height() - 1, x, 0, color);
    delay(0);
  }
  for (int16_t y = 0; y < tft.height(); y += 6) {
    tft.drawLine(tft.width() - 1, tft.height() - 1, 0, y, color);
    delay(0);
  }
}

void testdrawtext(char *text, uint16_t color) {
  tft.setCursor(100, 100);
  tft.setTextColor(color);
  tft.setTextWrap(true);
  tft.print(text);
}

void testfastlines(uint16_t color1, uint16_t color2) {
  tft.fillScreen(ST77XX_BLACK);
  for (int16_t y = 0; y < tft.height(); y += 5) {
    tft.drawFastHLine(0, y, tft.width(), color1);
  }
  for (int16_t x = 0; x < tft.width(); x += 5) {
    tft.drawFastVLine(x, 0, tft.height(), color2);
  }
}

void testdrawrects(uint16_t color) {
  tft.fillScreen(ST77XX_BLACK);
  for (int16_t x = 0; x < tft.width(); x += 6) {
    tft.drawRect(tft.width() / 2 - x / 2, tft.height() / 2 - x / 2, x, x, color);
  }
}

void testfillrects(uint16_t color1, uint16_t color2) {
  tft.fillScreen(ST77XX_BLACK);
  for (int16_t x = tft.width() - 1; x > 6; x -= 6) {
    tft.fillRect(tft.width() / 2 - x / 2, tft.height() / 2 - x / 2, x, x, color1);
    tft.drawRect(tft.width() / 2 - x / 2, tft.height() / 2 - x / 2, x, x, color2);
  }
}

void testfillcircles(uint8_t radius, uint16_t color) {
  for (int16_t x = radius; x < tft.width(); x += radius * 2) {
    for (int16_t y = radius; y < tft.height(); y += radius * 2) {
      tft.fillCircle(x, y, radius, color);
    }
  }
}

void testdrawcircles(uint8_t radius, uint16_t color) {
  for (int16_t x = 0; x < tft.width() + radius; x += radius * 2) {
    for (int16_t y = 0; y < tft.height() + radius; y += radius * 2) {
      tft.drawCircle(x, y, radius, color);
    }
  }
}

void testtriangles() {
  // tft.fillScreen(ST77XX_BLACK);
  uint16_t color = 0xF800;
  int t;
  int w = tft.width() / 2;
  int x = tft.height() - 1;
  int y = 0;
  int z = tft.width();
  for (t = 0; t <= 15; t++) {
    tft.drawTriangle(w, y, y, x, z, x, color);
    x -= 4;
    y += 4;
    z -= 4;
    color += 200;
    delay(100);
  }
}

void testroundrects() {
  tft.fillScreen(ST77XX_BLACK);
  uint16_t color = 100;
  int i;
  int t;
  for (t = 0; t <= 4; t += 1) {
    int x = 0;
    int y = 0;
    int w = tft.width() - 2;
    int h = tft.height() - 2;
    for (i = 0; i <= 16; i += 1) {
      tft.drawRoundRect(x, y, w, h, 5, color);
      x += 2;
      y += 3;
      w -= 4;
      h -= 6;
      color += 1100;
    }
    color += 100;
  }
}

void tftPrintTest() {
  tft.setTextWrap(false);
  tft.fillScreen(ST77XX_BLACK);
  tft.setCursor(0, 30);
  tft.setTextColor(ST77XX_RED);
  tft.setTextSize(1);
  tft.println("Hello World!");
  tft.setTextColor(ST77XX_YELLOW);
  tft.setTextSize(2);
  tft.println("Hello World!");
  tft.setTextColor(ST77XX_GREEN);
  tft.setTextSize(3);
  tft.println("Hello World!");
  tft.setTextColor(ST77XX_BLUE);
  tft.setTextSize(4);
  tft.print(1234.567);
  delay(1500);
  tft.setCursor(0, 0);
  tft.fillScreen(ST77XX_BLACK);
  tft.setTextColor(ST77XX_WHITE);
  tft.setTextSize(0);
  tft.println("Hello World!");
  tft.setTextSize(1);
  tft.setTextColor(ST77XX_GREEN);
//   tft.print(p, 6);
  tft.println(" Want pi?");
  tft.println(" ");
  tft.print(8675309, HEX);  // print 8,675,309 out in HEX!
  tft.println(" Print HEX!");
  tft.println(" ");
  tft.setTextColor(ST77XX_WHITE);
  tft.println("Sketch has been");
  tft.println("running for: ");
  tft.setTextColor(ST77XX_MAGENTA);
  tft.print(millis() / 1000);
  tft.setTextColor(ST77XX_WHITE);
  tft.print(" seconds.");
}

void mediabuttons() {
  // play
  tft.fillScreen(ST77XX_BLACK);
  tft.fillRoundRect(25, 10, 78, 60, 8, ST77XX_WHITE);
  tft.fillTriangle(42, 20, 42, 60, 90, 40, ST77XX_RED);
  delay(500);
  // pause
  tft.fillRoundRect(25, 90, 78, 60, 8, ST77XX_WHITE);
  tft.fillRoundRect(39, 98, 20, 45, 5, ST77XX_GREEN);
  tft.fillRoundRect(69, 98, 20, 45, 5, ST77XX_GREEN);
  delay(500);
  // play color
  tft.fillTriangle(42, 20, 42, 60, 90, 40, ST77XX_BLUE);
  delay(50);
  // pause color
  tft.fillRoundRect(39, 98, 20, 45, 5, ST77XX_RED);
  tft.fillRoundRect(69, 98, 20, 45, 5, ST77XX_RED);
  // play color
  tft.fillTriangle(42, 20, 42, 60, 90, 40, ST77XX_GREEN);
}


static const unsigned char PROGMEM image_battery_90_bits[] = {0x00,0x00,0x00,0x0f,0xff,0xfe,0x10,0x00,0x01,0x11,0x55,0x55,0x71,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0x00,0x00};

static const unsigned char PROGMEM image_camera_bits[] = {0x00,0x78,0x00,0x30,0x84,0x00,0x7f,0x7b,0x00,0xc0,0x00,0x80,0x91,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0x00,0x00};

static const unsigned char PROGMEM image_folder_open_file_bits[] = {0x00,0x00,0x00,0x7c,0x00,0x00,0x83,0xfc,0x00,0x80,0x02,0x00,0x80,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0x00,0x00};

static const unsigned char PROGMEM image_image_3_bits[] = {0x00,0x00,0x00,0x00,0x00,0x00,0x20,0x00,0x00,0x00,0x00,0x00,0x00,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0x00,0x00};

void draw(void) {
    // tft.clearDisplay();

    // battery_90
    tft.drawBitmap(124, 8, image_battery_90_bits, 24, 16, 0xAAA0);

    // camera
    tft.drawBitmap(26, 21, image_camera_bits, 17, 16, 0x4D85);

    // folder_open_file
    tft.drawBitmap(122, 45, image_folder_open_file_bits, 18, 16, 0xA815);

    // image
    tft.drawBitmap(8, 59, image_image_3_bits, 100, 59, 0xA800);

    // tft.display();
}



static const unsigned char PROGMEM image_battery_0_bits[] = {0x00,0x00,0x00,0x0f,0xff,0xfe,0x10,0x00,0x01,0x10,0x40,0x41,0x70,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0x00,0x00};

static const unsigned char PROGMEM image_file_film_dia_bits[] = {0xff,0xfe,0xbf,0xfa,0xe0,0x0e,0xa0,0x0a,0xe0,0x0e,0xa0,0x0a,0xe0,0x0e,0xbf,0xfa,0xff,0xfe,0xa0,0x0a,0xe0,0x0e,0xa0,0x0a,0xe0,0x0e,0xa0,0x0a,0xff,0xfe,0xbf,0xfa};

static const unsigned char PROGMEM image_wifi_2_bars_bits[] = {0x01,0xf0,0x00,0x06,0x0c,0x00,0x18,0x03,0x00,0x21,0xf0,0x80,0x46,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0x00,0x00};

static const unsigned char PROGMEM image_passport_okay1_bits[] = {0x7f,0xff,0xff,0xff,0xff,0xf8,0xff,0xff,0xff,0xff,0xff,0xfc,0xff,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0xff,0xf8};

static const unsigned char PROGMEM image_BatteryBody_bits[] = {0x03,0x3f,0xff,0xff,0xff,0xff,0xf0,0x03,0xf0,0x00,0x00,0x00,0x00,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0xff,0xf0};

static const unsigned char PROGMEM image__4E31D6EE_4B54_4CC6_8D8B_AC82C3D62C1F_bits[] = {0x00,0x00,0x00,0x00,0x00,0x00,0x00,0x00,0x00,0x00,0x00,0x00,0x00,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0xff,0xf8};

 
void draw1(void) {
    // battery_0
    tft.drawBitmap(122, 4, image_battery_0_bits, 24, 16, 0xA584);

    // file_film_dia
    tft.drawBitmap(85, 94, image_file_film_dia_bits, 15, 16, 0xFFFF);

    // wifi_2_bars
    tft.drawBitmap(100, 22, image_wifi_2_bars_bits, 19, 16, 0xA800);

    // passport_okay1
    tft.drawBitmap(105, 73, image_passport_okay1_bits, 46, 49, 0x57EA);

    // BatteryBody
    tft.drawBitmap(99, 42, image_BatteryBody_bits, 52, 28, 0xFABF);

    // _4E31D6EE_4B54_4CC6_8D8B_AC82C3D62C1F
    tft.drawBitmap(-1, -1, image__4E31D6EE_4B54_4CC6_8D8B_AC82C3D62C1F_bits, 85, 128, 0xBDAD);

}
